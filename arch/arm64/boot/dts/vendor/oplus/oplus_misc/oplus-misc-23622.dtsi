#include "oplus-misc-23609.dtsi"

&pm7550ba_eusb2_repeater {
	qcom,param-override-seq = <0x0f 0x51 0x06 0x53 0x02 0x54 0x07 0x57>;
	qcom,param-override-seq-host = <0x05 0x51 0x06 0x53 0x02 0x54 0x02 0x57>;
};